## main/Kconfig.projbuild
```kconfig
menu "Wifi Configuration"

config WIFI_SSID
    string "WiFi SSID"
    help
        SSID (network name) for the device to connect to.

config WIFI_PASSWORD
    string "WiFi Password"
    help
        WiFi password (WPA or WPA2) for the device to use.

        Can be left blank if the network has no security set.

config MQTT_CLIENT_ID
    string "MQTT Client ID"
    default "myesp32"
    help
        MQTT Client ID for this device.

endmenu
```
